## config/boards/shields/42/Kconfig.defconfig
```kconfig
if SHIELD_42_LEFT

config ZMK_SPLIT_ROLE_CENTRAL
    default y

config ZMK_KEYBOARD_NAME
    default "42 Keyboard"

endif

if SHIELD_42_LEFT || SHIELD_42_RIGHT

config ZMK_SPLIT
    default y

endif
```

## config/boards/shields/42/Kconfig.shield
```kconfig
config SHIELD_42_LEFT
    def_bool $(shields_list_contains, 42_left)

config SHIELD_42_RIGHT
    def_bool $(shields_list_contains, 42_right)
```
